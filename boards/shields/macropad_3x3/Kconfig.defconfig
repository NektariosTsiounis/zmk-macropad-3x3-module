## boards/shields/macropad_3x3/Kconfig.defconfig
```kconfig
# Macropad Configuration
if SHIELD_MACROPAD_3X3

config ZMK_KEYBOARD_NAME
    default "Macropad"

if ZMK_DISPLAY

config I2C
    default y

config SSD1306
    default y

endif # ZMK_DISPLAY

if LVGL

config LV_Z_VDB_SIZE
    default 64

config LV_DPI_DEF
    int
    default 148

config LV_Z_BITS_PER_PIXEL
    default 1

endif # LVGL

endif
```

## config/west.yml
```yaml
manifest:
  remotes:
    - name: zmkfirmware
      url-base: https://github.com/zmkfirmware
    - name: nektariostsiounis
      url-base: https://github.com/nektariostsiounis
  projects:
    - name: zmk
      remote: zmkfirmware
      revision: main
      import: app/west.yml
    - name: zmk-macropad-3x3-module
      remote: nektariostsiounis
      revision: main
  self:
    path: config
```
